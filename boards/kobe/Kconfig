## boards/kobe/Kconfig.board
```kconfig
config  BOARD_KOBE
        bool "Kobe Board"
        select SOC_QUARK_SE
	depends on X86
```

## boards/kobe_sss/Kconfig
```kconfig
if BOARD_KOBE_SSS

config BOARD
        default "kobe_sss"

endif # BOARD_KOBE_SSS
```

## boards/kobe_sss/Kconfig.board
```kconfig
config  BOARD_KOBE_SSS
        bool "Kobe Board - Sensor Sub System"
        select SOC_QUARK_SE_SS
        depends on ARC
```

## boards/sharkjumper/Kconfig
```kconfig
if BOARD_SHARKJUMPER

config BOARD
        default "sharkjumper"

endif # BOARD_SHARKJUMPER
```

## boards/sharkjumper/Kconfig.board
```kconfig
config  BOARD_SHARKJUMPER
        bool "Sharkjumper Board (Lakemont)"
        select SOC_QUARK_SE
	depends on X86
```

## boards/sharkjumper_sss/Kconfig
```kconfig
if BOARD_SHARKJUMPER_SSS

config BOARD
        default "sharkjumper_sss"

endif # BOARD_SHARKJUMPER_SSS
```

## boards/sharkjumper_sss/Kconfig.board
```kconfig
config  BOARD_SHARKJUMPER_SSS
        bool "Sharkjumper Board - Sensor Sub System"
        select SOC_QUARK_SE_SS
    depends on ARC
```
